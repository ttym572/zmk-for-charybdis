## config/west.yml
```yaml
manifest:
  remotes:
    - name: zmkfirmware
      url-base: https://github.com/zmkfirmware  # 改为官方仓库
  projects:
    - name: zmk
      remote: zmkfirmware
      revision: 3.3.0  # 使用稳定版本
      import: app/west.yml
  self:
    path: config
```
